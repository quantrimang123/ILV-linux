## buildroot_configs/ilvdistro_defconfig
```kconfig
BR2_x86_64=y
BR2_x86_haswell=y
BR2_TOOLCHAIN_EXTERNAL=y
BR2_TOOLCHAIN_EXTERNAL_PRE_INSTALLED=y
BR2_TOOLCHAIN_EXTERNAL_PATH="/opt/gcc-13"
BR2_TOOLCHAIN_EXTERNAL_PREFIX="x86_64-linux"
BR2_TOOLCHAIN_EXTERNAL_GLIBC=y
BR2_PACKAGE_BUSYBOX=y
```
